## src/application/samples/products/ble_ota_dongle/Kconfig
```kconfig
#===============================================================================
# @brief    Kconfig file.
# Copyright (c) HiSilicon (Shanghai) Technologies Co., Ltd. 2024-2024. All rights reserved.
#===============================================================================
config SLE_MTU_LENGTH
    int
    prompt "Set the length of mtu."
    default 300
    help
        This option means the length of mtu.
```

## src/application/samples/products/ble_ota_server/Kconfig
```kconfig
#===============================================================================
# @brief    Kconfig file.
# Copyright (c) HiSilicon (Shanghai) Technologies Co., Ltd. 2023-2023. All rights reserved.
#===============================================================================

config MIDDLEWARE_SUPPORT_UPDATE
        bool
        prompt "Update Config"
        default n
        config BT_UPG_ENABLE
            bool
            prompt "ENABLE BLE OTA."
            default n
            depends on MIDDLEWARE_SUPPORT_UPDATE

config MIDDLEWARE_SUPPORT_OTA_SERVICE
        bool
        prompt "OTA Service Config"
        default y
        config BT_OTA_SERVICE_ENABLE
            bool
            prompt "ENABLE BLE OTA SERVICE."
            default y
            depends on MIDDLEWARE_SUPPORT_OTA_SERVICE
```

## src/application/samples/products/sle_ble_gateway/Kconfig
```kconfig
#===============================================================================
# @brief    Kconfig file.
# Copyright (c) HiSilicon (Shanghai) Technologies Co., Ltd. 2024-2024. All rights reserved.
#===============================================================================

config GW_MAX_CONNECTIONS
    int
    prompt "Maximum simultaneous connections"
    range 2 16
    default 8
    depends on SAMPLE_SUPPORT_SLE_BLE_GATEWAY
    help
        Maximum number of simultaneous SLE+BLE connections managed by the gateway.

config GW_DATA_MAX_LEN
    int
    prompt "Maximum payload size in bytes"
    range 20 512
    default 256
    depends on SAMPLE_SUPPORT_SLE_BLE_GATEWAY
    help
        Maximum data payload length for a single gateway message (bytes).
```

## vendor/Developers/demos/rotary_encoder/Kconfig
```kconfig
config SAMPLE_ROTARY_ENCODER_SW_PIN
    int
    prompt "Choose Rotary Encoder SW pin."
    depends on SAMPLE_ROTARY_ENCODER
    default 5
    help
        This option means choose the SW pin for rotary encoder.

config SAMPLE_ROTARY_ENCODER_DT_PIN
    int
    prompt "Choose Rotary Encoder DT pin."
    depends on SAMPLE_ROTARY_ENCODER
    default 6
    help
        This option means choose the DT pin for rotary encoder.

config SAMPLE_ROTARY_ENCODER_CLK_PIN
    int
    prompt "Choose Rotary Encoder CLK pin."
    depends on SAMPLE_ROTARY_ENCODER
    default 7
    help
        This option means choose the CLK pin for rotary encoder.

config SAMPLE_ROTARY_ENCODER_DEBUG
    bool
    prompt "Enable Rotary Encoder debug info"
    depends on SAMPLE_ROTARY_ENCODER
    default 0
    help
        This option means switch debug info print for rotary encoder.
```
